## boards/shields/nanokeeb/Kconfig.defconfig
```kconfig
# Copyright (c) 2025 The ZMK Contributors
# SPDX-License-Identifier: MIT

if SHIELD_NANOKEEB

config ZMK_KEYBOARD_NAME
    default "nanokeeb"

endif
```
